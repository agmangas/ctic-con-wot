//==========================================================================================================
//████████╗██╗  ██╗███████╗    ██╗   ██╗██╗  ████████╗██╗███╗   ███╗ █████╗ ████████╗███████╗
//╚══██╔══╝██║  ██║██╔════╝    ██║   ██║██║  ╚══██╔══╝██║████╗ ████║██╔══██╗╚══██╔══╝██╔════╝
//   ██║   ███████║█████╗      ██║   ██║██║     ██║   ██║██╔████╔██║███████║   ██║   █████╗
//   ██║   ██╔══██║██╔══╝      ██║   ██║██║     ██║   ██║██║╚██╔╝██║██╔══██║   ██║   ██╔══╝
//   ██║   ██║  ██║███████╗    ╚██████╔╝███████╗██║   ██║██║ ╚═╝ ██║██║  ██║   ██║   ███████╗
//   ╚═╝   ╚═╝  ╚═╝╚══════╝     ╚═════╝ ╚══════╝╚═╝   ╚═╝╚═╝     ╚═╝╚═╝  ╚═╝   ╚═╝   ╚══════╝
//
//██╗  ██╗██╗████████╗████████╗███████╗███╗   ██╗      ██╗  ██╗██╗██╗     ██╗     ██╗███╗   ██╗ ██████╗
//██║ ██╔╝██║╚══██╔══╝╚══██╔══╝██╔════╝████╗  ██║      ██║ ██╔╝██║██║     ██║     ██║████╗  ██║██╔════╝
//█████╔╝ ██║   ██║      ██║   █████╗  ██╔██╗ ██║█████╗█████╔╝ ██║██║     ██║     ██║██╔██╗ ██║██║  ███╗
//██╔═██╗ ██║   ██║      ██║   ██╔══╝  ██║╚██╗██║╚════╝██╔═██╗ ██║██║     ██║     ██║██║╚██╗██║██║   ██║
//██║  ██╗██║   ██║      ██║   ███████╗██║ ╚████║      ██║  ██╗██║███████╗███████╗██║██║ ╚████║╚██████╔╝
//╚═╝  ╚═╝╚═╝   ╚═╝      ╚═╝   ╚══════╝╚═╝  ╚═══╝      ╚═╝  ╚═╝╚═╝╚══════╝╚══════╝╚═╝╚═╝  ╚═══╝ ╚═════╝
//
//███╗   ███╗ █████╗  ██████╗██╗  ██╗██╗███╗   ██╗███████╗
//████╗ ████║██╔══██╗██╔════╝██║  ██║██║████╗  ██║██╔════╝
//██╔████╔██║███████║██║     ███████║██║██╔██╗ ██║█████╗
//██║╚██╔╝██║██╔══██║██║     ██╔══██║██║██║╚██╗██║██╔══╝
//██║ ╚═╝ ██║██║  ██║╚██████╗██║  ██║██║██║ ╚████║███████╗
//╚═╝     ╚═╝╚═╝  ╚═╝ ╚═════╝╚═╝  ╚═╝╚═╝╚═╝  ╚═══╝╚══════╝
//                                                                        By CTIC-Wot.
//==========================================================================================================

#include <Arduino.h>
#include <hal.h>

// Settings
const bool ROTATE_BY_INTERVALS = true; // Put inf false and will rotate forever
const bool IS_DEBUG = true;
const unsigned int INTERVAL_SECONDS = 570; // 9,5 minutes = 570 secs
const unsigned int ROTATION_SECONDS = 10;

const bool USE_BUTTON = true;
const bool EXECUTE_TESTING = true;

// Functions
void setup()
{
  InitSerialMonitor(IS_DEBUG);
  InitMotor();
  InitButton();

  if (EXECUTE_TESTING)
    TestMotor(USE_BUTTON);
  if (!ROTATE_BY_INTERVALS)
    MotorOn();
}

void loop()
{
  if (ROTATE_BY_INTERVALS)
  {
    MotorOff();
    
    if (USE_BUTTON)
      WaitForButton(true);

    WaitForSeconds(INTERVAL_SECONDS);
    MotorOn();
    WaitForSeconds(ROTATION_SECONDS);
  }
}